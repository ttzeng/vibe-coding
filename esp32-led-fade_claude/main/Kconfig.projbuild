## esp32-led-fade_claude/main/Kconfig.projbuild
```kconfig
menu "Blinky Example Configuration"

    orsource "$IDF_PATH/examples/common_components/env_caps/$IDF_TARGET/Kconfig.env_caps"

    config GPIO_LED
        int "The blinky LED GPIO output pin"
        range ENV_GPIO_RANGE_MIN ENV_GPIO_OUT_RANGE_MAX
        default 8
        help
            The GPIO pin numbder assigned to a LED.

endmenu
```

## grove-lcd-display-project_claude/components/grove_lcd_rgb/Kconfig
```kconfig
menu "Grove LCD RGB Configuration"

    config GROVE_LCD_SCL_GPIO
        int "SCL GPIO Pin"
        default 9
        range 0 21
        help
            GPIO pin for I2C SCL signal.
            Default is GPIO9 for ESP32-C3 Super Mini.

    config GROVE_LCD_SDA_GPIO  
        int "SDA GPIO Pin"
        default 8
        range 0 21
        help
            GPIO pin for I2C SDA signal.
            Default is GPIO8 for ESP32-C3 Super Mini.

    config GROVE_LCD_I2C_FREQ_HZ
        int "I2C Clock Frequency (Hz)"
        default 100000
        range 10000 1000000
        help
            I2C master clock frequency. Standard mode is 100kHz, fast mode is 400kHz.

endmenu
```
